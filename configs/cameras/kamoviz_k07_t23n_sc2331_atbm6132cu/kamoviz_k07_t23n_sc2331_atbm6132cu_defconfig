## configs/cameras/kamoviz_k07_t23n_sc2331_atbm6132cu/kamoviz_k07_t23n_sc2331_atbm6132cu_defconfig
```kconfig
# NAME: Jooan C9TS-U (T23N, SC2336P, ATBM6132U)
# FRAG: soc-xburst1 core ssl
BR2_PACKAGE_THINGINO_KOPT_MMC0=y
BR2_PACKAGE_THINGINO_KOPT_MMC0_PB_4BIT=y
BR2_PACKAGE_WIFI=y
BR2_PACKAGE_WIFI_ATBM6132CU=y
BR2_SENSOR_1_NAME="sc2331"
BR2_INGENIC_SOC_MODEL="t23n"
BR2_THINGINO_AUDIO=y
BR2_THINGINO_AUDIO_GPIO=39
BR2_THINGINO_AUDIO_GPIO_LOW=y
BR2_THINGINO_BUTTON=y
BR2_THINGINO_SDCARD=y
BR2_THINGINO_LED_B_GPIO=46
BR2_THINGINO_LED_W_GPIO=60
FLASH_SIZE_MB=8
```
